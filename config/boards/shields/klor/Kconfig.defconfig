## config/boards/shields/klor/Kconfig.defconfig
```kconfig
# Copyright (c) 2022 GEIST
# SPDX-License-Identifier: MIT


if SHIELD_KLOR_LEFT

    config ZMK_KEYBOARD_NAME
        default "KLOR"

    config ZMK_SPLIT_BLE_ROLE_CENTRAL
        default y

endif # LEFT



if SHIELD_KLOR_LEFT || SHIELD_KLOR_RIGHT

    config ZMK_SPLIT
        default y

    config ZMK_DISPLAY
            select LVGL_USE_CONT
            select LVGL_USE_LABEL
            select LVGL_USE_IMG
            select LVGL_FONT_MONTSERRAT_26

    choice ZMK_DISPLAY_STATUS_SCREEN
            default ZMK_DISPLAY_STATUS_SCREEN_CUSTOM
    endchoice

    if ZMK_DISPLAY

        config I2C
            default y

        config SSD1306
            default y

        config SSD1306_REVERSE_MODE
            default y

        choice LVGL_THEME_DEFAULT_FONT_NORMAL
            default LVGL_THEME_DEFAULT_FONT_NORMAL_MONTSERRAT_26

        endchoice

        choice LVGL_THEME_DEFAULT_FONT_SMALL
            default LVGL_THEME_DEFAULT_FONT_SMALL_MONTSERRAT_26

        endchoice


        config LVGL_HOR_RES_MAX
            default 128

        config LVGL_VER_RES_MAX
            default 64

        config LVGL_VDB_SIZE
            default 64

        config LVGL_DPI
            default 148

        config LVGL_BITS_PER_PIXEL
            default 1

        choice LVGL_COLOR_DEPTH
            default LVGL_COLOR_DEPTH_1
        endchoice
        

    endif # ZMK_DISPLAY

    menuconfig CUSTOM_WIDGET_BATTERY_STATUS
        bool "custom battery status widget"

    menuconfig CUSTOM_WIDGET_OUTPUT_STATUS
        bool "custom output status widget"

    menuconfig CUSTOM_WIDGET_PROFILE_STATUS
        bool "custom profile status widget"

endif # LEFT RIGHT
```

## config/west.yml
```yaml
manifest:
  remotes:
    - name: schadenn
      url-base: https://github.com/schadenn
    - name: MangoIV
      url-base: https://github.com/MangoIV
    - name: zmkfirmware
      url-base: https://github.com/zmkfirmware
  projects:
    - name: zmk
      remote: zmkfirmware
      revision: main 
      # a1e0607a22deb72ce4ac64e442f0baa721e32b0b
      import: app/west.yml
  self:
    path: config
```
